## Documentation/devicetree/bindings/display/panel/samsung,s6e3fa0.yaml
```yaml
# SPDX-License-Identifier: (GPL-2.0-only OR BSD-2-Clause)
%YAML 1.2
---
$id: http://devicetree.org/schemas/display/panel/samsung,s6e3fa0.yaml#
$schema: http://devicetree.org/meta-schemas/core.yaml#

title: Samsung S6E3FA0 LCD amoled DSI command mode panel

maintainers:
  - Adam Honse <calcprogrammer1@gmail.com>

allOf:
  - $ref: panel-common.yaml#

properties:
  compatible:
    oneOf:
      - enum:
          - samsung,s6e3fa0

  reg: true
  reset-gpios: true
  port: true

  iovdd-supply:
    description: IOVDD regulator

  vddr-supply:
    description: VDDR regulator

required:
  - reg
  - compatible
  - reset-gpios
  - iovdd-supply
  - vddr-supply

additionalProperties: false

examples:
  - |
    /* from Samsung Galaxy Note 3 (samsung-hlte) */
    #include <dt-bindings/gpio/gpio.h>

    dsi {
        #address-cells = <1>;
        #size-cells = <0>;

        panel@0 {
            compatible = "samsung,s6e3fa2";
            reg = <0>;

            reset-gpios = <&pma8084_gpios 17 GPIO_ACTIVE_LOW>;

            iovdd-supply = <&pma8084_lvs4>;
            vddr-supply = <&vreg_panel>;

            port {
                panel_in: endpoint {
                    remote-endpoint = <&dsi0_out>;
                };
            };
        };
    };

...
```
